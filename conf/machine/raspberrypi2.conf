## conf/machine/raspberrypi2.conf
```bitbake
#@TYPE: Machine
#@NAME: RaspberryPi 2 Development Board
#@DESCRIPTION: Machine configuration for the RaspberryPi 2
+#@RDK_FLAVOR: rdkb
+#@NEEDED_BSPLAYERS: meta-raspberrypi

DEFAULTTUNE ?= "cortexa7thf-neon-vfpv4"

require conf/machine/include/tune-cortexa7.inc
include conf/machine/include/rpi-base.inc
```
